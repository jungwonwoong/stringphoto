#include <Stepper.h>
#include <Servo.h>
#include <SoftwareSerial.h>
SoftwareSerial mySerial(12, 13); // RX, TX
#define cdiv 320
#define dirPin 8
#define stepPin 9
#define enaPin 10
Servo servo;
Servo servo1;
int sw1 = 11;
int celPin =3;
// int led1 = 11;
int outStart = 0;
int inStart = 0;
int upStart = 0;
int downStart = 0;
int Step=0;
int nowDeg=80;//100deg 안쪽끝 170deg 바깥쪽 끝 saw 에 사용할 deg 80 150
int nowHigh=120;//150deg 바닦 50deg 천정 saw 에 사용할 deg 150 100
int outleng = 0;
int inleng = 86;
int upleng = 0; 
int downleng = 75;
unsigned long thisMillis_old;
unsigned long allMillis;
int cRotS = 850;
int cRotAdd = 6;

const float deg[] PROGMEM= {0.00,1.12,2.25,3.38,4.50,5.63,6.75,7.88,9.00,10.13,11.25,12.38,13.50,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357.75,358.88};
int num[cdiv] = {0};
//시연2600
const uint16_t data[] PROGMEM ={244,287,272,255,286,245,279,264,247,276,254,290,241,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299,0};
int dataSize = sizeof(data)/2;
int restart = -1;
int restartcount = 0;
bool drc = HIGH;
int pinperstep = 40/4;
int idxplus = 0;
void setup() {
  Serial.begin(9600);
  mySerial.begin(9600);
  Serial.println(dataSize);
  pinMode(LED_BUILTIN, OUTPUT);
  // pinMode(led1, OUTPUT);
  pinMode(sw1, INPUT_PULLUP);
  pinMode(enaPin, OUTPUT);
  digitalWrite(enaPin, LOW);
  pinMode(stepPin, OUTPUT);
  pinMode(dirPin, OUTPUT);
  pinMode(celPin, INPUT_PULLUP);
  for(int i=0;i<cdiv;i++) {
    num[i] = i;
  }
  servo.attach(5);
  servo1.attach(6);
}
int k=-1;
char buf[21];
void loop() {
  if(digitalRead(sw1) == LOW){
    Serial.println(LED_BUILTIN);
    digitalWrite(LED_BUILTIN, HIGH);
    // digitalWrite(led1, HIGH); 
    digitalWrite(enaPin, HIGH);
    if(k < 0) k=0; 
    thisMillis_old = millis();
    outStart = analogRead(A2);
    inStart = analogRead(A3);
    upStart = analogRead(A0);
    downStart = analogRead(A1);
    if(inStart > 900) nowDeg=nowDeg+1;
    if(outStart > 900) nowDeg=nowDeg-1;
    if(downStart > 900) nowHigh=nowHigh+1;
    else if(upStart > 900) nowHigh=nowHigh-1;
    servo1.write(nowHigh);
    servo.write(nowDeg);
    delay(10);
    downleng=nowHigh;
    inleng = nowDeg;
    outleng=inleng+80;
    upleng=downleng+50;
    if(analogRead(A5) > 900 && analogRead(A4) < 900) {
      oneStep(HIGH);
    }
    if(analogRead(A4) > 900 && analogRead(A5) < 900) {
      oneStep(LOW);
    }
    if(digitalRead(celPin) == LOW) {//간격 테스트 시작
      for(int j=0;j<320;j++){
        digitalWrite(enaPin, LOW);
        delay(50);
        servo.write(outleng);//원 밖으로 나감
        delay(100);
        servo1.write(upleng);//아래로 내려감
        for (int i = 0; i < pinperstep; i++) {
          digitalWrite(stepPin, HIGH);
          delayMicroseconds(1450);
          digitalWrite(stepPin, LOW);
          delayMicroseconds(1450);
        }
        delay(100);
        servo.write(inleng);// 원 안으로 들어감
        servo1.write(downleng);//위로 올라감
        delay(150);
        if(analogRead(A4) > 900 || analogRead(A5) > 900) {
          digitalWrite(enaPin, HIGH);
          break;
        }
      }
    } 
  } else {
    // digitalWrite(led1, LOW);
    Serial.println("off");
    digitalWrite(LED_BUILTIN, LOW);
    char v = ' ';
    if (Serial.available()) {
      v = Serial.read();
    }
    if(k>=0 && k <= dataSize){//} && v == 'q'){
      digitalWrite(enaPin, LOW);
      if(k!=0 && k%200 == 0) {upleng--;downleng--;}
      unsigned long deltaMillis = 0;//작업 시간 측정값
      unsigned long thisMillis = millis();
      Serial.print(pgm_read_word_near(&(data[k])));//시리얼 모니터에 지금 걸어야할 핀 번호와 카운트를 출력
      Serial.print(", ");// 이후에 이부분은 소켓으로 서버 모니터에 출력되도록 할 것임
      Serial.print(k);
      Serial.print("  ");
      unsigned long allSeconds=allMillis/1000;
      int runHours= allSeconds/3600;
      int secsRemaining=allSeconds%3600;
      int runMinutes=secsRemaining/60;
      int runSeconds=secsRemaining%60;
      char buf[21];
      sprintf(buf,"Runtime%02d:%02d:%02d",runHours,runMinutes,runSeconds);
      Serial.println(buf);
      
      int idx = index_arr(num, cdiv, pgm_read_word_near(&(data[k])));
      shiftLeft(num, idx, cdiv);
      //Serial.println(pgm_read_word_near(&(data[k])));
      if(idx == 160) { //다음 핀이 정반대에 위치하는 경우 0으로 나누는 오류때문에 따로 정한방향으로 디스크 이동
        drc = LOW;
        if(arr_check(num, (cdiv-idx), cdiv, pgm_read_word_near(&(data[k+1]))) > 0) {
          cRotate(drc, ((idx+idxplus)-1)*pinperstep);
          sawing(drc);
          idxplus=0;
        } else {
          cRotate(drc, (idx+idxplus)*pinperstep);
          sawing(!drc);
          idxplus=1;
          delay(50);
        }
      } else {
        if(1/sin(radians(pgm_read_float_near(&(deg[idx])))) > 0) { // 오른쪽으로 도는 경우
          drc = LOW;
          if(arr_check(num, (cdiv-idx), cdiv, pgm_read_word_near(&(data[k+1]))) > 0) { // 오른쪽으로 돌고 다음 턴은 왼쪽인데 지나온 길에 있는 곳으로
            cRotate(drc, ((idx+idxplus)-1)*pinperstep); // 오른쪽으로 도는데 한칸 덜 가기
            sawing(drc);
            idxplus=0;
          } else { // 오른쪽으로 돌고 다음 턴도 오른쪽
            cRotate(drc, (idx+idxplus)*pinperstep);
            idxplus=1;
            sawing(!drc);
            delay(50);
          }
        } else if(1/sin(radians(pgm_read_float_near(&(deg[idx])))) < 0) {// 왼쪽으로 도는 경우
          drc = HIGH;
          if(arr_check(num, 0, cdiv-idx, pgm_read_word_near(&(data[k+1]))) > 0) {
            cRotate(drc, (cdiv-(idx+idxplus))*pinperstep);
            sawing(drc);
            idxplus=1;
            delay(50);
          } else {
            cRotate(drc, ((cdiv-(idx+idxplus))+1)*pinperstep);
            sawing(!drc);
            idxplus=0;
          }
        }
      }
      k=k+1;
      if (thisMillis != thisMillis_old) {
        deltaMillis = thisMillis-thisMillis_old;
        thisMillis_old = thisMillis;
        allMillis = allMillis + deltaMillis;
      } 
    }
    if(k > dataSize) { // 모든 작업이 끝나면
      k=-1;
      for(int i=0;i<2;i++){
        delay(300);
        sawing(HIGH);
        cRotate(LOW, pinperstep);
      }
      delay(300);
      sawing(LOW);
      cRotate(HIGH, pinperstep);
      sawing(LOW);
      // 총 작업시간을 시:분:초 로 출력
      unsigned long allSeconds=allMillis/1000;
      int runHours= allSeconds/3600;
      int secsRemaining=allSeconds%3600;
      int runMinutes=secsRemaining/60;
      int runSeconds=secsRemaining%60;
      char buf[21];
      sprintf(buf,"Runtime%02d:%02d:%02d",runHours,runMinutes,runSeconds);
      //Serial.print(buf);
      //digitalWrite(enaPin, HIGH);
      allMillis=0;
    }
  }
}
void oneStep(bool dic) {
  digitalWrite(dirPin, dic);
  digitalWrite(enaPin, LOW);
  digitalWrite(stepPin, HIGH);
  delayMicroseconds(1450);
  digitalWrite(stepPin, LOW);
  delayMicroseconds(1450);
  delay(500);
}
void callibration(bool cal, bool dic, int sw) {
  digitalWrite(dirPin, dic);
  digitalWrite(enaPin, LOW);
  for(int i=2000;i>500;i=i-1) {
    digitalWrite(stepPin, HIGH);
    delayMicroseconds(i);
    digitalWrite(stepPin, LOW);
    delayMicroseconds(i);
    if(analogRead(sw) < 900 || analogRead(A4)+analogRead(A5) > 1800) {
      //digitalWrite(enaPin, HIGH);
      break;
    }
  }
  while (cal) {
    if(analogRead(sw) < 900 || analogRead(A4)+analogRead(A5) > 1800) {
      //digitalWrite(enaPin, HIGH);
      cal=false;
    }
    digitalWrite(stepPin, HIGH);
    delayMicroseconds(500);
    digitalWrite(stepPin, LOW);
    delayMicroseconds(500);
  }

}
void sawing(bool drc){
   delay(100);
  servo.write(outleng);//원 밖으로 나감
  delay(100);
  servo1.write(upleng);//아래로 내려감
  delay(50);
  cRotate(drc, pinperstep);
   delay(100);
  servo.write(inleng);// 원 안으로 들어감
  servo1.write(downleng);//위로 올라감
  delay(200);
}
int arr_check(int* arr, int start, int end, int val){
  for(int i = start; i < end; i++){
  if(arr[i] == val) return 1;
  }
  return -1;
}
void cRotate(bool direc, int spr) {
 digitalWrite(dirPin, direc);
 //Serial.println(spr);
  if(spr/40 >= 5 && spr/40 <= 40) {
    //Serial.println("200이상 1600미만");
    for(int j=cRotS; j > cRotS-100*cRotAdd; j=j-1*cRotAdd){
      digitalWrite(stepPin, HIGH);
      delayMicroseconds(j);
      digitalWrite(stepPin, LOW);
      delayMicroseconds(j);
    }
    for(int k=0; k < spr-200; k++){
      digitalWrite(stepPin, HIGH);
      delayMicroseconds(cRotS-100*cRotAdd);
      digitalWrite(stepPin, LOW);
      delayMicroseconds(cRotS-100*cRotAdd);
    }
    for(int l=cRotS-100*cRotAdd; l < cRotS; l=l+1*cRotAdd){
      digitalWrite(stepPin, HIGH);
      delayMicroseconds(l);
      digitalWrite(stepPin, LOW);
      delayMicroseconds(l);
    }
  // } else if(spr/40 >= 40) {
  //   //Serial.println("1600이상");
  //   for(int j=cRotS; j > cRotS-200*cRotAdd; j=j-1*cRotAdd){
  //     digitalWrite(stepPin, HIGH);
  //     delayMicroseconds(j);
  //     digitalWrite(stepPin, LOW);
  //     delayMicroseconds(j);
  //   }
  //   for(int k=0; k < spr-400; k++){
  //     digitalWrite(stepPin, HIGH);
  //     delayMicroseconds(cRotS-200*cRotAdd);
  //     digitalWrite(stepPin, LOW);
  //     delayMicroseconds(cRotS-200*cRotAdd);
  //   }
  //   for(int l=cRotS-200*cRotAdd; l < cRotS; l=l+1*cRotAdd){
  //     digitalWrite(stepPin, HIGH);
  //     delayMicroseconds(l);
  //     digitalWrite(stepPin, LOW);
  //     delayMicroseconds(l);
  //   }
  // } 
  }else {
    //Serial.println("200미만");
    //Serial.println("---------------------");
    for (int i = 0; i < spr; i++) {
      digitalWrite(stepPin, HIGH);
      delayMicroseconds(cRotS);
      digitalWrite(stepPin, LOW);
      delayMicroseconds(cRotS);
    }
  }
  
}
void shiftLeft(int arr[], int d, int n) {
    reverse(arr, 0, d);
    reverse(arr, d, n);
    reverse(arr, 0, n);
}
void reverse(int arr[], int start, int end) {
    int temp;
    end = end - 1;
    while (start < end) {
        temp = arr[start];
        arr[start] = arr[end];
        arr[end] = temp;
        start++;
        end--;
    }
}
int index_arr(int* arr, int size, int val){
  for(int i = 0; i < size; i++){
  if(arr[i] == val) return i;
  }
  return -1;
}
